## CMakeLists.txt
```
# SPDX-License-Identifier: Apache-2.0

cmake_minimum_required(VERSION 3.13.1)

# Override the binary used by qemu
set(QEMU_KERNEL_OPTION "-device;loader,file=${CMAKE_BINARY_DIR}/tfm_qemu.hex")

find_package(Zephyr REQUIRED HINTS $ENV{ZEPHYR_BASE})

project(tfm_psa_level_1)

# Source files in this sample
target_sources(app PRIVATE src/end_node.c)
target_sources(app PRIVATE src/main.c)
target_sources(app PRIVATE src/provisioning.c)
target_sources(app PRIVATE src/psa_attestation.c)
target_sources(app PRIVATE src/psa_crypto.c)
target_sources(app PRIVATE src/root_ca.c)
target_sources(app PRIVATE src/shell.c)
target_sources(app PRIVATE src/tfm_ipc.c)
target_sources(app PRIVATE src/util_app_cfg.c)
target_sources(app PRIVATE src/util_app_log.c)
target_sources(app PRIVATE src/util_sformat.c)
```

## Kconfig
```
# Private config options for PSA level 1 application

# Copyright (c) 2019,2020 Linaro
# SPDX-License-Identifier: Apache-2.0

mainmenu "PSA level 1 sample application"

menu "Application configuration"

module = PSA
module-str = psa
source "subsys/logging/Kconfig.template.log_config"

endmenu

config PSA_SHELL
	bool "Enable the 'psa' shell command"
	depends on SHELL
	help
	  Enabling this option will make the 'psa' shell command available.

choice
	prompt "Private Key"

config PRIVATE_KEY_STATIC
	bool "Static"
	help
	  A static key value will be used for the private key.

config PRIVATE_KEY_RANDOM
	bool "Random"
	help
	  A randomly generated value will be used for the private key.

endchoice

config APPLICATION_THREAD_TIMEOUT
	int 
	default 10000
	help
	  Threads sleep for 1s, wake up and check for messages.

source "Kconfig.zephyr"
```

## sample.yaml
```
sample:
    description: This app provides an example of using TF-M on the secure
        side, with Zephyr on the NS side, using IPC mode. Zephyr handles
        all levels of certification. There are 3 threads, Root CA, Provisioning
        and End Node.
    name: TF-M PSA Handshake Simple implementation.
tests:
    sample.psa_level_1:
        tags: introduction
        platform_allow: mps2_an521_nonsecure lpcxpresso55s69_ns nrf5340pdk_nrf5340_cpuappns
          nrf5340dk_nrf5340_cpuappns nrf9160dk_nrf9160ns
        harness: console
        harness_config:
          type: multi_line
          regex:
            - "Retrieving public key for key #1"
            - "Signature verified"
            - "Destroyed persistent key #1"
```

## prj.conf
```kconfig
CONFIG_LOG=y
CONFIG_LOG_RUNTIME_FILTERING=y
CONFIG_LOG_BUFFER_SIZE=2048
CONFIG_LOG_PROCESS_TRIGGER_THRESHOLD=0
CONFIG_LOG_DEFAULT_LEVEL=4

#CONFIG_SHELL=n
#CONFIG_SHELL_HISTORY=y
#CONFIG_SHELL_VT100_COLORS=y
#CONFIG_SHELL_CMDS=n
#CONFIG_PSA_SHELL=y

CONFIG_BUILD_WITH_TFM=y

# The Zephyr CMSIS emulation assumes that ticks are ms, currently
CONFIG_SYS_CLOCK_TICKS_PER_SEC=1000

# CONFIG_MAIN_STACK_SIZE=16384
# CONFIG_HEAP_MEM_POOL_SIZE=16384

CONFIG_MAIN_STACK_SIZE=40960
CONFIG_HEAP_MEM_POOL_SIZE=40960
CONFIG_SYSTEM_WORKQUEUE_STACK_SIZE=40960

CONFIG_USERSPACE=y
```

## src/main.c
```c
/*
 * Copyright (c) 2019,2020 Linaro Limited
 *
 * SPDX-License-Identifier: Apache-2.0
 */

#include <zephyr.h>
#include <logging/log_ctrl.h>
#include <logging/log.h>

#include "util_app_log.h"
#include "util_sformat.h"

#include "common_objects.h"

/** Declare a reference to the application logging interface. */
LOG_MODULE_DECLARE(app, CONFIG_LOG_DEFAULT_LEVEL);

#define STACK_SIZE 16384

#define END_NODE_PRIORITY 		7
#define PROVISIONING_PRIORITY	6
#define ROOT_CA_PRIORITY 		7

K_KERNEL_STACK_DEFINE(end_node_stack, STACK_SIZE);
K_THREAD_STACK_DEFINE(provisioning_stack, STACK_SIZE);
K_THREAD_STACK_DEFINE(root_ca_stack, STACK_SIZE);

K_MBOX_DEFINE(ca_root_mailbox);
K_MBOX_DEFINE(end_node_mailbox);

struct k_thread end_node;
struct k_thread provisioning;
struct k_thread root_ca;

k_tid_t end_node_tid;
k_tid_t provisioning_tid;
k_tid_t root_ca_tid;

void main(void)
{
	/* Initialise the logger subsys and dump the current buffer. */
	log_init();

	LOG_INF(">>>>> Begin main initialization <<<<<");

	/* provisioning thread is the main thread that starts the process and
	handles end-node <-> root-ca interactions. Provisioning thread is the
	equivalent to a user terminal that connects another device to a cloud.
	*/

	provisioning_tid = k_thread_create(&provisioning, provisioning_stack,
								STACK_SIZE,
								(k_thread_entry_t)provisioning_entry,
								NULL, NULL, NULL,
								K_PRIO_COOP(PROVISIONING_PRIORITY),
								0, K_NO_WAIT);

	root_ca_tid = k_thread_create(&root_ca, root_ca_stack,
								STACK_SIZE,
								(k_thread_entry_t)root_ca_entry,
								NULL, NULL, NULL,
								K_PRIO_COOP(ROOT_CA_PRIORITY),
								0, K_NO_WAIT);

	/* end-node needs to handle all the communications with the secure side. */
	end_node_tid = k_thread_create(&end_node, end_node_stack,
								STACK_SIZE,
								(k_thread_entry_t)end_node_entry,
								NULL, NULL, NULL,
								K_PRIO_COOP(END_NODE_PRIORITY),
								0, K_NO_WAIT);

	while(1){
		/* Sleep for some time and ... */
		k_msleep(CONFIG_APPLICATION_THREAD_TIMEOUT);

		/* dump any queued log messages, and wait for system events. */
		al_dump_log();
	};
	
	LOG_INF(">>>>> Done main initialization <<<<<");
}
```

## src/common_objects.h
```c
#include <zephyr.h>
#include <kernel.h>


extern struct k_mbox ca_root_mailbox;
extern struct k_mbox end_node_mailbox;

extern void end_node_entry(void *, void *, void *);
extern void provisioning_entry(void *, void *, void *);
extern void root_ca_entry(void *, void *, void *);

extern struct k_thread end_node;
extern struct k_thread provisioning;
extern struct k_thread root_ca;

extern k_tid_t end_node_tid;
extern k_tid_t provisioning_tid;
extern k_tid_t root_ca_tid;

typedef enum {
    NACK,
    ACK,
    ARE_YOU_UP,
    GIVE_YOURSELF_A_KEY,
    HERES_YOUR_CSR
} msg_types;
```

## src/end_node.c
```c
/*
 * Copyright (c) 2020 NXP
 *
 * SPDX-License-Identifier: Apache-2.0
 */

#include <logging/log_ctrl.h>
#include <logging/log.h>

#include "util_app_log.h"
#include "util_sformat.h"

#include "tfm_ns_interface.h"
#include "psa_attestation.h"
#include "psa_crypto.h"
#include "util_app_cfg.h"

#include "common_objects.h"

LOG_MODULE_REGISTER(end_node);

/* Create an instance of the system config struct for the application. */
static struct cfg_data cfg;

void send_provisioning_msg(uint32_t type, char* buffer, uint32_t receive_size)
{
    struct k_mbox_msg send_msg;

    /* prepare to send empty message */
    send_msg.info = type;
    send_msg.size = 0;
    send_msg.tx_data = NULL;
    send_msg.tx_block.data = NULL;
    send_msg.tx_target_thread = provisioning_tid;

    /* send message and wait until a consumer receives it */
    LOG_INF("send_provisioning_msg %u <<", type);
    k_mbox_put(&end_node_mailbox, &send_msg, K_FOREVER);
}

/*  input buffer[size]
    return message type */
uint32_t get_provisioning_msg(char* buffer, size_t size)
{
    struct k_mbox_msg recv_msg;

    /* prepare to receive message */
    recv_msg.size = size;
    recv_msg.rx_source_thread = provisioning_tid;

    /* get message, but not its data */
    k_mbox_get(&end_node_mailbox, &recv_msg, NULL, K_FOREVER);

    /* get message data for only certain types of messages */
    /* retrieve message data and delete the message */
    k_mbox_data_get(&recv_msg, buffer);
    LOG_INF("get_provisioning_msg %u <<", recv_msg.info);

    return recv_msg.info;
}


void end_node_entry(void *dummy1, void *dummy2, void *dummy3)
{
    msg_types info_type;
    enum tfm_status_e tfm_status;
    char buffer[100] = {99,88,77};
    LOG_INF("Thread started.");

    /* wait to get initialization commands */
    info_type = get_provisioning_msg(NULL, 0);
    if (info_type == ARE_YOU_UP) {
        /* Initialize the TFM NS interface */
        tfm_status = tfm_ns_interface_init();

        /* When done, send ACK, we are up */
        if (TFM_SUCCESS == tfm_status) {
            send_provisioning_msg(ACK, NULL, 0);
        } else {
            send_provisioning_msg(NACK, NULL, 0);
        }
    }

	/* Load app config struct from secure storage (create if missing). */
	if (cfg_load_data(&cfg)) {
		LOG_ERR("Error loading/generating app config data in SS.");
	}

	/* Get the entity attestation token (requires ~1kB stack memory!). */
	// att_test();

    info_type = get_provisioning_msg(NULL, 0);
    if (info_type == GIVE_YOURSELF_A_KEY) {
        LOG_INF("GIVE_YOURSELF_A_KEY <<");
	    /* Randomly generate the private key. */
	    uint8_t priv_key_data[32] = { 0 };
	    tfm_status = psa_generate_random(priv_key_data, sizeof(priv_key_data));
        LOG_INF("priv_key_data %x %x %x %x <<", priv_key_data[0],priv_key_data[1],priv_key_data[2],priv_key_data[3]);

        if (TFM_SUCCESS == tfm_status) {
            //this does not actually works
            tfm_status = psa_ps_set(cfg.magic, sizeof(priv_key_data),
                        (void *)priv_key_data, 0);

            if (TFM_SUCCESS == tfm_status)
            send_provisioning_msg(ACK, NULL, 0);
        } else {
            send_provisioning_msg(NACK, NULL, 0);
        }

        /* Crypto tests */
	    crp_test(priv_key_data);
    } else {
        LOG_INF("No give a key mssg? <<");
    }

    while (1){

        // if ('Provision device' is received) {
        //     access key
        //     unique device identifier
        //     add public key/unique id to CSR binary

        //     send CSR binary

        //     wait for abort or go
        //     if ('Abort Provisioning') {
        //         cleanup
        //     } else {
        //         get certificate chain
        //         store certificate chain
        //         send 'Provisioning complete'
        //     }
        // } else {
            k_msleep(CONFIG_APPLICATION_THREAD_TIMEOUT);
        // }

        //maybe exit in case of reset and provider launch thread.
    }

    LOG_INF("Thread exited, provisioning is complete.");
}
```

## src/provisioning.c
```c
/*
 * Copyright (c) 2020 NXP
 *
 * SPDX-License-Identifier: Apache-2.0
 */

#include <logging/log_ctrl.h>
#include <logging/log.h>

#include "common_objects.h"

LOG_MODULE_REGISTER(provisioning);

void send_end_node(uint32_t type, char* buffer, size_t size)
{
    struct k_mbox_msg send_msg;

    /* prepare to send empty message */
    send_msg.info = type;
    send_msg.size = 0;
    send_msg.tx_data = NULL;
    send_msg.tx_block.data = NULL;
    send_msg.tx_target_thread = end_node_tid;

    /* send message and wait until a consumer receives it */
    LOG_INF("send_end_node %u <<", type);
    k_mbox_put(&end_node_mailbox, &send_msg, K_FOREVER);
}

/*  input buffer[size]
    return message type */
uint32_t get_end_node(char* buffer, size_t size)
{
    struct k_mbox_msg recv_msg;

    /* prepare to receive message */
    recv_msg.size = size;
    recv_msg.rx_source_thread = end_node_tid;

    /* get message, but not its data */
    k_mbox_get(&end_node_mailbox, &recv_msg, NULL, K_FOREVER);

    /* get message data for only certain types of messages */
    /* retrieve message data and delete the message */
    k_mbox_data_get(&recv_msg, buffer);
    LOG_INF("get_end_node %u <<", recv_msg.info);

    return recv_msg.info;
}

void provisioning_entry(void *p1, void *p2, void *p3)
{
    msg_types info_type;
    char buffer[100]={66,55,44,22,100};
    LOG_INF("Thread started.");

    /* Connect to end-node. */
    /* Is end-node thread up? */
    send_end_node(ARE_YOU_UP, NULL, 0);
    info_type = get_end_node(NULL, 0);
    if (info_type == ACK) {
        LOG_INF("end_node thread is up.");
    } else {
        LOG_INF("Does not work.");
    }

    /* Send 'Provision Device' command to end-node. */
    send_end_node(GIVE_YOURSELF_A_KEY, NULL, 0);
    info_type = get_end_node(NULL, 0);
    if (info_type == ACK) {
        LOG_INF("end_node generated a private key.");
    } else {
        LOG_INF("end_node can't generate a private key.");
    }

    //message starting provisioning
    //wait for CSR binary blob

    /* Send CSR binary to root-ca. */
    //copy and send copy CSR to root-ca thread
    //wait for rejection or signed certificate

    // if (rejection) {}
    //     send 'abort provision'
    // } else {

    //     receive certificare chain binary blob
    //     copy and send copy to end-node

    //     receive 'provisioning complete' from end-node
    //     send 'provisioning complete' to root-ca
    // }

    // reset end-node

    // check the certificate in end-node with root-ca

    k_msleep(CONFIG_APPLICATION_THREAD_TIMEOUT);

    LOG_INF("Thread exited, end node was reset.");
}
```

## src/psa_crypto.c
```c
/*
 * Copyright (c) 2019,2020 Linaro Limited
 *
 * SPDX-License-Identifier: Apache-2.0
 */

#include <zephyr.h>
#include <logging/log_ctrl.h>
#include <logging/log.h>

#include "psa_crypto.h"
#include "util_app_log.h"
#include "util_sformat.h"

/** Declare a reference to the application logging interface. */
LOG_MODULE_DECLARE(app, CONFIG_LOG_DEFAULT_LEVEL);

/* Formatting details for displaying hex dumps. */
struct sf_hex_tbl_fmt crp_fmt = {
	.ascii = true,
	.addr_label = true,
	.addr = 0
};

/**
 * @brief Extracts the public key from the specified persistent key id.
 *
 * @param key_id        The permament identifier for the generated key.
 * @param key           Pointer to the buffer where the public key data
 *                      will be written.
 * @param key_buf_size  Size of key buffer in bytes.
 * @param key_len       Number of bytes written into key by this function.
 */
static psa_status_t crp_get_pub_key(psa_key_id_t key_id,
				    uint8_t *key, size_t key_buf_size,
				    size_t *key_len)
{
	psa_status_t status;
	psa_key_handle_t key_handle;

	LOG_INF("Retrieving public key for key #%d", key_id);
	al_dump_log();

	/* Now try to re-open the persisted key based on the key ID. */
	status = al_psa_status(
		psa_open_key(key_id, &key_handle),
		__func__);
	if (status != PSA_SUCCESS) {
		LOG_ERR("Failed to open persistent key #%d", key_id);
		goto err;
	}

	/* Export the persistent key's public key part. */
	status = al_psa_status(
		psa_export_public_key(key_handle, key, key_buf_size, key_len),
		__func__);
	if (status != PSA_SUCCESS) {
		LOG_ERR("Failed to export public key.");
		goto err;
	}

	/* Display the binary key data for debug purposes. */
	sf_hex_tabulate_16(&crp_fmt, key, *key_len);

	/* Close the key to free up the volatile slot. */
	status = al_psa_status(
		psa_close_key(key_handle),
		__func__);
	if (status != PSA_SUCCESS) {
		LOG_ERR("Failed to close persistent key.");
		goto err;
	}

	return status;
err:
	al_dump_log();
	return status;
}

/**
 * @brief Stores a new permanent, persistent prime256v1 (ecdsa-with-SHA256) key
 *        in ITS, associating it with the specified unique key identifier.
 *
 * This function will store a new permament prime256v1 key in internal trusted
 * storage. Cryptographic operations can then be performed using the key
 * identifier (key_id) associated with this persistent key. Only the 32-byte
 * private key needs to be supplied, the public key can be derived using
 * the supplied private key value.
 *
 * @param key_id        The permament identifier for the generated key.
 * @param key_usage     The usage policy for the key.
 * @param key_data      Pointer to the 32-byte private key data.
 */
static psa_status_t crp_gen_key_secp256r1(psa_key_id_t key_id,
					  psa_key_usage_t key_usage,
					  uint8_t *key_data)
{
	psa_status_t status = PSA_SUCCESS;
	psa_key_attributes_t key_attributes = PSA_KEY_ATTRIBUTES_INIT;
	psa_key_type_t key_type =
		PSA_KEY_TYPE_ECC_KEY_PAIR(PSA_ECC_CURVE_SECP256R1);
	psa_algorithm_t alg = PSA_ALG_ECDSA(PSA_ALG_SHA_256);
	psa_key_handle_t key_handle;
	size_t key_len = 32;
	size_t data_len;
	uint8_t data_out[65] = { 0 }; /* ECDSA public key = 65 bytes. */
	int comp_result;

	LOG_INF("Persisting SECP256R1 key as #%d", (uint32_t)key_id);
	al_dump_log();

	/* Setup the key's attributes before the creation request. */
	psa_set_key_id(&key_attributes, key_id);
	psa_set_key_usage_flags(&key_attributes, key_usage);
	psa_set_key_algorithm(&key_attributes, alg);
	psa_set_key_type(&key_attributes, key_type);

	/* Import the private key, creating the persistent key on success */
	status = al_psa_status(
		psa_import_key(&key_attributes, key_data, key_len, &key_handle),
		__func__);
	if (status != PSA_SUCCESS) {
		LOG_ERR("Failed to import key.");
		goto err;
	}

	/* Close the key to free up the volatile slot. */
	status = al_psa_status(
		psa_close_key(key_handle),
		__func__);
	if (status != PSA_SUCCESS) {
		LOG_ERR("Failed to close persistent key.");
		goto err;
	}

	/* Try to retrieve the public key. */
	status = crp_get_pub_key(key_id, data_out, sizeof(data_out), &data_len);

	/* Export the private key if usage includes PSA_KEY_USAGE_EXPORT. */
	if (key_usage & PSA_KEY_USAGE_EXPORT) {
		/* Re-open the persisted key based on the key ID. */
		status = al_psa_status(
			psa_open_key(key_id, &key_handle),
			__func__);
		if (status != PSA_SUCCESS) {
			LOG_ERR("Failed to open persistent key #%d", key_id);
			goto err;
		}

		/* Read the original (private) key data back. */
		status = al_psa_status(
			psa_export_key(key_handle, data_out,
				       sizeof(data_out), &data_len),
			__func__);
		if (status != PSA_SUCCESS) {
			LOG_ERR("Failed to export key.");
			goto err;
		}

		/* Check key len. */
		if (data_len != key_len) {
			LOG_ERR("Unexpected number of bytes in exported key.");
			goto err;
		}

		/* Verify that the exported private key matches input data. */
		comp_result = memcmp(data_out, key_data, key_len);
		if (comp_result != 0) {
			LOG_ERR("Imported/exported private key mismatch.");
			goto err;
		}

		/* Display the private key. */
		LOG_INF("Private key data:");
		al_dump_log();
		sf_hex_tabulate_16(&crp_fmt, data_out, data_len);

		/* Close the key to free up the volatile slot. */
		status = al_psa_status(
			psa_close_key(key_handle),
			__func__);
		if (status != PSA_SUCCESS) {
			LOG_ERR("Failed to close persistent key.");
			goto err;
		}
	}

	return status;
err:
	al_dump_log();
	return status;
}

/**
 * @brief Calculates the SHA256 hash for the supplied message.
 *
 * @param msg           Pointer to the buffer to read when generating the hash.
 * @param msg_len       Number of bytes in msg.
 * @param hash          Pointer to the buffer where the hash should be written.
 * @param hash_buf_size Size of hash in bytes.
 * @param hash_len      Placeholder for the number of hash bytes written.
 */
static psa_status_t crp_hash_payload(uint8_t *msg, size_t msg_len,
				     uint8_t *hash, size_t hash_buf_size,
				     size_t *hash_len)
{
	psa_status_t status;
	psa_hash_operation_t hash_handle = psa_hash_operation_init();
	psa_algorithm_t alg = PSA_ALG_SHA_256;

	LOG_INF("Calculating SHA-256 hash of value");
	al_dump_log();

	/* Display the input message */
	sf_hex_tabulate_16(&crp_fmt, msg, msg_len);

	/* Setup the hash object. */
	status = al_psa_status(psa_hash_setup(&hash_handle, alg),
			       __func__);
	if (status != PSA_SUCCESS) {
		LOG_ERR("Failed to setup hash op.");
		goto err;
	}

	/* Update object with all the message chunks. */
	/* For the moment, the message is passed in a single operation, */
	/* but this can be broken up in chunks for larger messages. */
	status = al_psa_status(psa_hash_update(&hash_handle, msg, msg_len),
			       __func__);
	if (status != PSA_SUCCESS) {
		LOG_ERR("Failed to update hash.");
		goto err;
	}

	/* Finalize the hash calculation. */
	status = al_psa_status(psa_hash_finish(&hash_handle,
					       hash, hash_buf_size, hash_len),
			       __func__);
	if (status != PSA_SUCCESS) {
		LOG_ERR("Failed to finalize hash op.");
		goto err;
	}

	/* Display the SHA-256 hash for debug purposes */
	sf_hex_tabulate_16(&crp_fmt, hash, (size_t)(PSA_HASH_SIZE(alg)));

	return status;
err:
	psa_hash_abort(&hash_handle);
	al_dump_log();
	return status;
}

/**
 * @brief Signs the supplied hash using the specified persistent key.
 *
 * @param key_id        The identifier of the key to use when signing.
 * @param hash          Pointer to the buffer where the hash should be written.
 * @param hash_buf_size Size of hash in bytes.
 * @param sig           Pointer to the buffer to read when generating the sig.
 * @param sig_buf_size  Size of sig buffer in bytes.
 * @param sig_len       Number of bytes written to sig.
 */
static psa_status_t crp_sign_hash(psa_key_id_t key_id,
				  uint8_t *hash, size_t hash_buf_size,
				  uint8_t *sig, size_t sig_buf_size,
				  size_t *sig_len)
{
	psa_status_t status;
	psa_key_handle_t key_handle;

	LOG_INF("Signing SHA-256 hash");
	al_dump_log();

	/* Try to open the persisted key based on the key ID. */
	status = al_psa_status(
		psa_open_key(key_id, &key_handle),
		__func__);
	if (status != PSA_SUCCESS) {
		LOG_ERR("Failed to open persistent key #%d", key_id);
		goto err;
	}

	/* Sign using psa_sign_hash. */
	status = al_psa_status(
		psa_sign_hash(key_handle,
			      PSA_ALG_ECDSA(PSA_ALG_SHA_256),
			      hash, hash_buf_size,
			      sig, sig_buf_size, sig_len),
		__func__);
	if (status != PSA_SUCCESS) {
		LOG_ERR("Failed to sign hash w/persistent key #%d", key_id);
		goto err;
	}

	/* Display the ECDSA signature for debug purposes */
	sf_hex_tabulate_16(&crp_fmt, sig, *sig_len);

	/* You can test this same operation with openssl as follows:
	 *
	 * $ openssl dgst -sha256 -sign
	 */

	/* Close the key to free up the volatile slot. */
	status = al_psa_status(
		psa_close_key(key_handle),
		__func__);
	if (status != PSA_SUCCESS) {
		LOG_ERR("Failed to close persistent key.");
		goto err;
	}

	return status;
err:
	al_dump_log();
	return status;
}

/**
 * @brief Verifies the hash signature using the public key associated
 *        with key_id.
 *
 * @param key_id        The identifier for the persistent key.
 * @param hash          Pointer to the hash data to verify.
 * @param hash_len      Size of the hash buffer in bytes.
 * @param sig           Pointer to the signature buffer.
 * @param sig_len       Size of the signature buffer in bytes.
 */
static psa_status_t crp_verify_sign(psa_key_id_t key_id,
				    uint8_t *hash, size_t hash_len,
				    uint8_t *sig, size_t sig_len)
{
	psa_status_t status;
	psa_key_handle_t key_handle;

	LOG_INF("Verifying signature for SHA-256 hash");
	al_dump_log();

	/* Try to open the persisted key based on the key ID. */
	status = al_psa_status(
		psa_open_key(key_id, &key_handle),
		__func__);
	if (status != PSA_SUCCESS) {
		LOG_ERR("Failed to open persistent key #%d", key_id);
		goto err;
	}

	/* Verify the hash signature. */
	status = al_psa_status(
		psa_verify_hash(key_handle,
				PSA_ALG_ECDSA(PSA_ALG_SHA_256),
				hash, hash_len,
				sig, sig_len),
		__func__);
	if (status != PSA_SUCCESS) {
		LOG_ERR("Signature verification failed!");
		goto err;
	}

	LOG_INF("Signature verified.");
	al_dump_log();

	/* Close the key to free up the volatile slot. */
	status = al_psa_status(
		psa_close_key(key_handle),
		__func__);
	if (status != PSA_SUCCESS) {
		LOG_ERR("Failed to close persistent key.");
		goto err;
	}

	return status;
err:
	al_dump_log();
	return status;
}

/**
 * @brief Destroys the specified persistent key.
 *
 * @param key_id        The identifier for the persistent key.
 */
static psa_status_t crp_dest_key(psa_key_id_t key_id)
{
	psa_status_t status;
	psa_key_handle_t key_handle;

	/* Try to open the persisted key based on the key ID. */
	status = al_psa_status(
		psa_open_key(key_id, &key_handle),
		__func__);
	if (status != PSA_SUCCESS) {
		LOG_ERR("Failed to open persistent key #%d", key_id);
		goto err;
	}

	/* Destroy the persistent key */
	status = al_psa_status(
		psa_destroy_key(key_handle),
		__func__);
	if (status != PSA_SUCCESS) {
		LOG_ERR("Failed to destroy a persistent key");
		goto err;
	}

	LOG_INF("Destroyed persistent key #%d", (uint32_t)key_id);
	al_dump_log();

	return status;
err:
	al_dump_log();
	return status;
}

void crp_test(uint8_t* priv_key_data)
{
	psa_status_t status;
	uint8_t msg[] = "Please hash and sign this message.";
	uint8_t hash[PSA_HASH_SIZE(PSA_ALG_SHA_256)] = { 0 };
	size_t hash_len;
	uint8_t sig[PSA_VENDOR_ECDSA_SIGNATURE_MAX_SIZE] = { 0 };
	size_t sig_len;

	/* Initialize crypto API. */
	status = al_psa_status(psa_crypto_init(), __func__);
	if (status != PSA_SUCCESS) {
		LOG_ERR("Crypto init failed.");
		return;
	}

	/* NOTE: The same key generation, SHA256 hash, sign, and verify
	 * operations performed in this file can be also performed with
	 * openssl using the commands described below.
	 *
	 * Generate a new key:
	 *
	 *   $ openssl ecparam -name prime256v1 -genkey -out user.pem
	 *
	 * Display the public and private keys in hexadecimal format:
	 *
	 *   $ openssl ec -in user.pem -text -noout
	 *
	 * Update the private key value in priv_key_data with the hexadecimal
	 * values from "priv:" to be able to compare the PSA API and openssl
	 * output.
	 *
	 * Generate a PEM file with the public key (which will be used to
	 * verify any data signed with the private key):
	 *
	 *   $ openssl ec -in user.pem -pubout -out user_pub.pem
	 *
	 * Hash the message with SHA256, and sign it with the private key:
	 *
	 *   $ echo "Please hash and sign this message." > message.txt
	 *   $ openssl dgst -sha256 -sign user.pem message.txt > signature.der
	 *
	 * Verify the signature using the public key and message file:
	 *
	 *   $ openssl dgst -sha256 -verify user_pub.pem \
	 *     -signature signature.der message.txt
	 *
	 * If everything ws OK you should see "Verified OK".
	 */

	/* Generate persistent prime256v1 (ecdsa-with-SHA256) key w/ID #1. */
	/* PSA_KEY_USAGE_EXPORT can be added for debug purposes. */
	status = crp_gen_key_secp256r1(1,
				       PSA_KEY_USAGE_SIGN_HASH |
				       PSA_KEY_USAGE_VERIFY_HASH,
				       priv_key_data);

	/* Hash some data with the key using SHA256. */
	status = crp_hash_payload(msg, strlen(msg),
				  hash, sizeof(hash), &hash_len);

	/* Sign the hash using key #1. */
	status = crp_sign_hash(1,
			       hash, sizeof(hash),
			       sig, sizeof(sig), &sig_len);

	/* Verify the hash signature using the public key. */
	status = crp_verify_sign(1, hash, hash_len, sig, sig_len);

	/* Destroy the key. */
	status = crp_dest_key(1);
}
```

## src/psa_crypto.h
```c
/*
 * Copyright (c) 2019,2020 Linaro Limited
 *
 * SPDX-License-Identifier: Apache-2.0
 */

#include <zephyr.h>

#include "psa/crypto.h"
#include "psa/error.h"

#ifdef __cplusplus
extern "C" {
#endif

/**
 * @brief Demonstrates how to calcute the SHA-256 hash of a value in chunks.
 */
void crp_test_sha256(void);

/**
 * @brief Runs a series of PSA Cryptography API test functions.
 */
void crp_test(uint8_t* priv_key_data);

#ifdef __cplusplus
}
#endif
```

## src/root_ca.c
```c
/*
 * Copyright (c) 2020 NXP
 *
 * SPDX-License-Identifier: Apache-2.0
 */

#include <logging/log_ctrl.h>
#include <logging/log.h>

#include "common_objects.h"

LOG_MODULE_REGISTER(root_ca);

/* Very important, see https://github.com/microbuilder/linaroca
   This is a server implementation of the root-ca that should work.
   */

void root_ca_entry(void *dummy1, void *dummy2, void *dummy3)
{
    LOG_INF("Thread started.");

    while(1) {
        k_msleep(CONFIG_APPLICATION_THREAD_TIMEOUT);

        /* Wait for CSR binary blob from provisioning device. */
        //check some mailbox maybe

        // if (bad) {
        //     send reject provisioning
        // } else {
        //     sign the certificate
        //     register device details
        //     generate signed certificate

        //     send certificate to provider

        //     wait for 'Provisioning complete'

        //     maybe list the new certified device
        //     maybe timeout removes the device
        // }
    }


    LOG_ERR("Thread exited, should not happen;\r\n"\
        "Certificate Authority should always be on and respond "\
        "to incoming requests.");
}
```

## src/util_app_cfg.c
```c
/*
 * Copyright (c) 2019,2020 Linaro Limited
 *
 * SPDX-License-Identifier: Apache-2.0
 */

#include <string.h>
#include <logging/log.h>

#include "psa/error.h"
#include "psa/protected_storage.h"
#include "psa/internal_trusted_storage.h"
#include "util_app_cfg.h"
#include "util_app_log.h"

/** The 64-bit UID associated with the config record in secure storage. */
static psa_storage_uid_t cfg_data_uid = 0x0000000055CFDA7A;

LOG_MODULE_DECLARE(app, CONFIG_LOG_DEFAULT_LEVEL);

/**
 * @brief Default config settings. These settings will be used when a new
 *        config record is created, or when the config record is reset.
 */
static struct cfg_data cfg_data_dflt = {
	.magic = 0x55CFDA7A,
	.version = 1,
	.scratch = { 0 }
};

psa_status_t cfg_create_data(void)
{
	psa_status_t status;

	LOG_INF("app_cfg: Creating new config file with UID 0x%llX",
		(uint64_t)cfg_data_uid);

	/*
	 * psa_ps_create can also be used here, which enables to the use of
	 * the psa_ps_set_extended function, but this requires us to set a
	 * maximum file size for resource allocation. Since the upper limit
	 * isn't known at present, we opt here for the simpler psa_ps_set
	 * call which also creates the secure storage record if necessary,
	 * but precludes the use of psa_ps_set_extended.
	 */
	status = psa_its_set(cfg_data_uid, sizeof(cfg_data_dflt),
			    (void *)&cfg_data_dflt, 0);
	if (status) {
		goto err;
	}

err:
	return (status ? al_psa_status(status, __func__) : status);
}

psa_status_t cfg_load_data(struct cfg_data *p_cfg_data)
{
	psa_status_t status;
	struct psa_storage_info_t p_info;

	memset(&p_info, 0, sizeof(p_info));

	/* Check if the config record exists, if not create it. */
	status = psa_its_get_info(cfg_data_uid, &p_info);
	if (status == PSA_ERROR_DOES_NOT_EXIST) {
		LOG_INF("----------------------app_cfg: New file");
		/* Create a new config file. */
		status = cfg_create_data();
		/* Copy default values to the cfg_data placeholder. */
		memcpy(p_cfg_data, &cfg_data_dflt, sizeof(cfg_data_dflt));
	} else {
		LOG_INF("----------------------app_cfg: using old file");
	}
	if (status) {
		goto err;
	}

err:
	return (status ? al_psa_status(status, __func__) : status);
}
```
