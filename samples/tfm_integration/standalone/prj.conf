## CMakeLists.txt
```
cmake_minimum_required(VERSION 3.13.1)
# Copyright (c) 2017, NXP
#
# SPDX-License-Identifier: Apache-2.0
#

set(REMOTE_ZEPHYR_DIR ${CMAKE_CURRENT_BINARY_DIR}/ns_img-prefix/src/ns_img-build/zephyr)

if("${BOARD}" STREQUAL "lpcxpresso55s69_cpu0")
  set(BOARD_REMOTE "lpcxpresso55s69_ns")
else()
  message(FATAL_ERROR "${BOARD} was not supported for this sample")
endif()

message(INFO " ${BOARD} compile as Master in this sample")

find_package(Zephyr REQUIRED HINTS $ENV{ZEPHYR_BASE})
project(tfm_sample)

enable_language(C ASM)

target_sources(app PRIVATE src/main_master.c)

include(ExternalProject)

ExternalProject_Add(
  ns_img
  SOURCE_DIR ${APPLICATION_SOURCE_DIR}/remote
  INSTALL_COMMAND ""      # This particular build system has no install command
  CMAKE_CACHE_ARGS -DBOARD:STRING=${BOARD_REMOTE}
  CMAKE_CACHE_ARGS -DDTC_OVERLAY_FILE:STRING=${DTC_OVERLAY_FILE}
  BUILD_BYPRODUCTS "${CMAKE_CURRENT_BINARY_DIR}/ns_img-prefix/src/ns_img-build/zephyr/zephyr.bin"
  BUILD_ALWAYS True
)

# add_dependencies(slave_core_inc_target ns_img)

target_include_directories(app PRIVATE ${CMAKE_CURRENT_SOURCE_DIR})
```

## prj.conf
```kconfig
# CONFIG_PRINTK=y
# CONFIG_IPM=y
# CONFIG_IPM_MCUX=y
# CONFIG_SLAVE_CORE_MCUX=y
# CONFIG_SLAVE_IMAGE_MCUX="${ZEPHYR_BINARY_DIR}/../ns_img-prefix/src/ns_img-build/zephyr/zephyr.bin"
# CONFIG_TIMESLICE_SIZE=1
# CONFIG_MAIN_STACK_SIZE=2048
CONFIG_PLATFORM_SPECIFIC_INIT=y
CONFIG_NS_IMAGE_BOOT=y
```

## src/main_master.c
```c
/*
 * Copyright (c) 2018, NXP
 *
 * SPDX-License-Identifier: Apache-2.0
 */

#include <zephyr.h>
#include <sys/printk.h>
#include <device.h>


void main(void)
{
	printk("Hello World from SECURE! %s\n", CONFIG_ARCH);

	while (1) {
	}
}
```
