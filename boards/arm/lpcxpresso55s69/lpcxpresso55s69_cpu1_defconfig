## boards/arm/lpcxpresso55s69/lpcxpresso55s69_cpu1_defconfig
```kconfig
#
# Copyright (c) 2019, NXP
#
# SPDX-License-Identifier: Apache-2.0
#

CONFIG_SOC_SERIES_LPC55XXX=y
CONFIG_SOC_LPC55S69_CPU1=y
CONFIG_BOARD_LPCXPRESSO55S69_CPU1=y
CONFIG_CONSOLE=y
CONFIG_USE_SEGGER_RTT=y
CONFIG_RTT_CONSOLE=y
CONFIG_SERIAL=n
CONFIG_CORTEX_M_SYSTICK=y
CONFIG_GPIO=y
CONFIG_GPIO_MCUX_LPC=y
CONFIG_PINMUX=y
CONFIG_SYS_CLOCK_HW_CYCLES_PER_SEC=96000000

CONFIG_BUILD_OUTPUT_HEX=y

CONFIG_RUNTIME_NMI=y
```

## boards/arm/lpcxpresso55s69/lpcxpresso55s69_ns_defconfig
```kconfig
#
# Copyright (c) 2019, NXP
#
# SPDX-License-Identifier: Apache-2.0
#

CONFIG_SOC_SERIES_LPC55XXX=y
CONFIG_SOC_LPC55S69_CPU0=y
CONFIG_BOARD_LPCXPRESSO55S69_CPU0=y
CONFIG_CONSOLE=y
CONFIG_UART_CONSOLE=y
CONFIG_SERIAL=y
CONFIG_UART_INTERRUPT_DRIVEN=y
CONFIG_CORTEX_M_SYSTICK=y
CONFIG_GPIO=y
CONFIG_PINMUX=y
CONFIG_SYS_CLOCK_HW_CYCLES_PER_SEC=96000000

# tfm_ipc sample doesn't work when MPU is enabled.
# To use the MPU, TFM_BOOT_MPU_PROTECTION must be disabled.
CONFIG_ARM_MPU=y

# Enable TrustZone-M
CONFIG_ARM_TRUSTZONE_M=y
CONFIG_TRUSTED_EXECUTION_NONSECURE=y
CONFIG_RUNTIME_NMI=y

CONFIG_BUILD_OUTPUT_HEX=y

# Flash configuration for TFM
CONFIG_FLASH_LOAD_OFFSET=0x40000
CONFIG_FLASH_LOAD_SIZE=0x20000
```

## drivers/flash/Kconfig.mcux
```kconfig
# SPDX-License-Identifier: Apache-2.0

config SOC_FLASH_MCUX
	bool "MCUX flash shim driver"
	depends on (HAS_MCUX_FTFX || HAS_MCUX_IAP)
	select FLASH_HAS_PAGE_LAYOUT
	select FLASH_HAS_DRIVER_ENABLED
	help
	  Enables the MCUX flash shim driver.
	  WARNING: This driver will disable the system interrupts for
	  the duration of the flash erase/write operations. This will
	  have an impact on the overall system performance - whether
	  this is acceptable or not will depend on the use case.

if SOC_FLASH_MCUX

config SW_MANAGED_FLASH_WRITE
	bool "MCUX flash software managed write"
	default n
	help
		Allows writing custom flash sizes.
		WARNING: This function is not safe, it may lead to corruption
		if power is lost, and intensive use will shorten flash
		memory's life.

endif #SOC_FLASH_MCUX
```

## dts/bindings/flash_controller/nxp,lpc-iap.yaml
```yaml
title: NXP LPC In Application Programming Flash Memory (IAP)

description: |
    This binding gives for the NXP LPC Flash Memory Controller

compatible: "nxp,lpc-iap"

include: flash-controller.yaml
```

## dts/bindings/rng/nxp,lpc-rng.yaml
```yaml
# Copyright (c) 2018, Linaro Limited
# SPDX-License-Identifier: Apache-2.0

description: LPC RNG (True Random Number Generator)

compatible: "nxp,lpc-rng"

include: base.yaml

properties:
    reg:
      required: true

    interrupts:
      required: false

    label:
      required: true
```

## soc/arm/nxp_lpc/lpc55xxx/Kconfig.soc
```kconfig
# LPC LPC55XXX Series

# Copyright (c) 2019, NXP
# SPDX-License-Identifier: Apache-2.0

choice
	prompt "LPC5500 Series MCU Selection"
	depends on SOC_SERIES_LPC55XXX

config SOC_LPC55S16
	bool "SOC_LPC55S16 M33"
	select CPU_CORTEX_M33
	select CPU_HAS_ARM_SAU
	select CPU_HAS_ARM_MPU
	select CPU_HAS_FPU
	select ARMV8_M_DSP
	select ARM_TRUSTZONE_M
	select CLOCK_CONTROL
	select HAS_MCUX_IAP if !TRUSTED_EXECUTION_NONSECURE

config SOC_LPC55S69_CPU0
	bool "SOC_LPC55S69 M33 [CPU 0]"
	select CPU_CORTEX_M33
	select CPU_HAS_ARM_SAU
	select CPU_HAS_ARM_MPU
	select CPU_HAS_FPU
	select ARMV8_M_DSP
	select ARM_TRUSTZONE_M
	select CLOCK_CONTROL
	select HAS_MCUX_IAP
	select HAS_MCUX_LPADC
	select HAS_MCUX_LPC_DMA
	# select PLATFORM_SPECIFIC_INIT
	# select SW_VECTOR_RELAY

config SOC_LPC55S69_CPU1
	bool "SOC_LPC55S69 M33 [CPU 1]"
	select CPU_CORTEX_M33
	# select SW_VECTOR_RELAY

endchoice

if SOC_SERIES_LPC55XXX

config SOC_PART_NUMBER_LPC55S16JBD100
	bool

config SOC_PART_NUMBER_LPC55S69JBD100
	bool

config SOC_PART_NUMBER_LPC55S69JET98
	bool

config SOC_PART_NUMBER_LPC55XXX
	string
	default "LPC55S16JBD100" if SOC_PART_NUMBER_LPC55S16JBD100
	default "LPC55S69JBD100" if SOC_PART_NUMBER_LPC55S69JBD100
	default "LPC55S69JET98"  if SOC_PART_NUMBER_LPC55S69JET98

	help
	  This string holds the full part number of the SoC. It is a hidden
	  option that you should not set directly. The part number selection
	  choice defines the default value for this string.

config SLAVE_CORE_MCUX
	bool "Enable LPC55xxx's second core"
	depends on HAS_MCUX
	help
	  Driver for slave core startup

config SLAVE_IMAGE_MCUX
	depends on SLAVE_CORE_MCUX
	string "Binary image of slave core's code"
	help
	  This points to the image file for the the binary code that will be
	  used by the slave core.

config SLAVE_BOOT_ADDRESS_MCUX
	depends on SLAVE_CORE_MCUX
	hex "Address the slave core will boot at"
	default 0x20030000
	help
	  This is the address the slave core will boot from.  Additionally this
	  address is where we will copy the SLAVE_IMAGE to.  We default this to
	  the base of SRAM3.

config NS_IMAGE_BOOT
	bool "NS Image"
	default n
	help
		No help for you.

endif # SOC_SERIES_LPC55XXX
```
