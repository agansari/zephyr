/* Copyright (c) 2019 Linaro
 * SPDX-License-Identifier: Apache-2.0
 */

&arduino_spi {
	status = "okay";
	cs-gpios = <&mikrobus_header 2 0>; /* CS */

	eth_click@0 {
		compatible = "microchip,enc28j60";
		local-mac-address = [00 00 00 01 02 03];
		spi-max-frequency = <10000000>; //errata specifies min 8Mhz, doc spec 20MHz max
		int-gpios = <&mikrobus_header 9 0>;	/* INT */
		label = "ETH_0";
		reg = <0>;
	};
};
